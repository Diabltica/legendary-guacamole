## boards/shields/legd/Kconfig.shield
```kconfig
config SHIELD_LEGD_LEFT
    def_bool $(shields_list_contains,legd_left)
  
config SHIELD_LEGD_RIGHT
    def_bool $(shields_list_contains,legd_right)
  
```
